## drivers/input/touchscreen/xiaomi/Kconfig
```kconfig
# SPDX-License-Identifier: GPL-2.0
#
# Xiaomi Touch Feature configuration
#

menu "Xiaomi Touchscreen Features"

config TOUCHSCREEN_XIAOMI_TOUCHFEATURE
	tristate "Xiaomi Touch Core Feature"
	depends on INPUT_TOUCHSCREEN
	help
	  Core Xiaomi touchscreen driver providing advanced touch handling
	  such as GameMode, PalmSensor, and related gesture features.

config TOUCHSCREEN_XIAOMI_TOUCHFEATURE_PALMSENSOR
	bool "Xiaomi Touch PalmSensor"
	depends on TOUCHSCREEN_XIAOMI_TOUCHFEATURE
	help
	  Enable palm rejection / palm detection support for Xiaomi touchscreen.

config TOUCHSCREEN_XIAOMI_TOUCHFEATURE_GAMEMODE
	bool "Xiaomi Touch GameMode"
	depends on TOUCHSCREEN_XIAOMI_TOUCHFEATURE
	help
	  Enable touch latency optimization and sensitivity tuning for gaming.

endmenu
```
